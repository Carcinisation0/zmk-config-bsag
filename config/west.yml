## config/west.yml
```yaml
manifest:
  remotes:
    - name: urob
      url-base: https://github.com/urob
    - name: zmkfirmware
      url-base: https://github.com/zmkfirmware
  projects:
    - name: zmk
      remote: urob
      revision: v0.3        # <-- KLUCZOWE; nie 'main'
      import: app/west.yml
    # ... reszta modułów (helpers, auto-layer, tri-state, totem itp.)
  self:
    path: config
```
